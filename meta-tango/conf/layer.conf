## meta-tango/conf/layer.conf
```bitbake
# We have a conf and classes directory, add to BBPATH
BBPATH .= ":${LAYERDIR}"

# We have recipes-* directories, add to BBFILES
BBFILES += "${LAYERDIR}/recipes-*/*/*.bb \
	${LAYERDIR}/recipes-*/*/*.bbappend"

BBFILE_COLLECTIONS += "tango"
BBFILE_PATTERN_tango = "^${LAYERDIR}/"
BBFILE_PRIORITY_tango = "6"
```

## ztango/conf/bblayers.conf
```bitbake
# LAYER_CONF_VERSION is increased each time build/conf/bblayers.conf
# changes incompatibly
LCONF_VERSION = "7"

BBPATH = "${TOPDIR}"
BBFILES ?= ""

BBLAYERS ?= " \
  /home/raph/zynq-tango/openembedded-core/meta \
  /home/raph/zynq-tango/openembedded-core/meta-skeleton \
  /home/raph/zynq-tango/openembedded-core/meta-xilinx \
  /home/raph/zynq-tango/meta-openembedded/meta-oe \
  /home/raph/zynq-tango/meta-tango \
  "
```

## ztango/conf/local.conf
```bitbake
BB_NUMBER_THREADS ?= "${@oe.utils.cpu_count()}"
PARALLEL_MAKE ?= "-j ${@oe.utils.cpu_count()}"

MACHINE ?= "zedboard-zynq7"
DL_DIR ?= "/home/raph/zynq-tango/downloads/"
SSTATE_DIR ?= "/home/raph/zynq-tango/ztango/sstate-cache/"
TMPDIR = "${TOPDIR}/tmp"
#DISTRO ?= "krogoth"

PACKAGE_CLASSES ?= "package_ipk"
IMAGE_FSTYPES_append = " ext4 "

PREFERRED_PROVIDER_virtual/kernel = "linux-adi" 
PREFERRED_VERSION_linux-adi = "4.6.0" 
EXTRA_IMAGE_FEATURES = "debug-tweaks "
#x11"
USER_CLASSES ?= "buildstats image-mklibs image-prelink "
IMAGE_INSTALL_append += " libgcc"
# zeromq omniorb4 tango dropbear ds openssl xterm opencv v4l-utils usbutils pkgconfig mpg123 cvdemo alsa-utils  i2c-tools gst-player gstreamer1.0-plugins-good gstreamer1.0-plugins-base gstreamer1.0-plugins-bad gstreamer1.0-plugins-ugly mplayer-common cvdemo alsa-utils  i2c-tools "

#set P_V (PREFERRED_VERSION) for libav and set empty 
PNBLACKLIST[mplayer2]=""

INSANE_SKIP_tango = "installed-vs-shipped"
LICENSE_FLAGS_WHITELIST="commercial"
COMMERCIAL_LICENSE += " ffmpeg "

PATCHRESOLVE = "noop"
BB_DISKMON_DIRS = "\
    STOPTASKS,${TMPDIR},1G,100K \
    STOPTASKS,${DL_DIR},1G,100K \
    STOPTASKS,${SSTATE_DIR},1G,100K \
    ABORT,${TMPDIR},100M,1K \
    ABORT,${DL_DIR},100M,1K \
    ABORT,${SSTATE_DIR},100M,1K" 
CONF_VERSION = "1"
```
